## west.yml
```yaml
manifest:
  remotes:
    - name: nrf-connect-sdk
      url-base: https://github.com/nrfconnect
  projects:
    - name: sdk-nrf
      remote: nrf-connect-sdk
      path: nrf
      revision: v1.9.1
      import: true
    - name: memfault-firmware-sdk
      url: https://github.com/memfault/memfault-firmware-sdk
      path: modules/memfault-firmware-sdk
      revision: 0.30.4
  self:
    path: memfault_demo_app
```
