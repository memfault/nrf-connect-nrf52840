## CMakeLists.txt
```
# SPDX-License-Identifier: Apache-2.0

cmake_minimum_required(VERSION 3.20.0)

find_package(Zephyr REQUIRED HINTS $ENV{ZEPHYR_BASE})
project(fs_shell)

FILE(GLOB app_sources src/*.c)
target_sources(app PRIVATE ${app_sources})

zephyr_include_directories(config)
```

## west.yml
```
manifest:
  remotes:
    - name: nrf-connect-sdk
      url-base: https://github.com/nrfconnect
  projects:
    - name: sdk-nrf
      remote: nrf-connect-sdk
      path: nrf
      revision: v2.0.0
      import: true
    - name: memfault-firmware-sdk
      url: https://github.com/memfault/memfault-firmware-sdk
      path: modules/memfault-firmware-sdk
      revision: 0.31.1
  self:
    path: memfault_demo_app
```

## prj.conf
```kconfig
CONFIG_HEAP_MEM_POOL_SIZE=16384
CONFIG_MAIN_STACK_SIZE=4096

CONFIG_SHELL=y
CONFIG_SHELL_LOG_LEVEL_INF=y

# hwinfo is used to get a unique device id from the chip id
CONFIG_HWINFO=y

# Enable Memfault
CONFIG_MEMFAULT=y
# Below config is set by default in Memfault SDK 0.30.5+
CONFIG_MEMFAULT_NRF_CONNECT_SDK=y

# Use internal flash to store the coredump
CONFIG_MEMFAULT_NCS_INTERNAL_FLASH_BACKED_COREDUMP=y
CONFIG_PM_PARTITION_SIZE_MEMFAULT_STORAGE=0x20000

# set a dummy project key; this setting is required by the nrf-connect
# integration, but it is unused in a non-HTTP application
CONFIG_MEMFAULT_NCS_PROJECT_KEY="xxxxxxxxxxxxxxxxxxxxxxxxxxxxxxxx"

# Disable root cert storage in our application by setting it to the non-existent
# modem
CONFIG_MEMFAULT_ROOT_CERT_STORAGE_CUSTOM=y

# Set device information fields
CONFIG_MEMFAULT_NCS_DEVICE_ID_RUNTIME=y
CONFIG_MEMFAULT_NCS_HW_VERSION="a"
CONFIG_MEMFAULT_NCS_FW_TYPE="nrf52_example"
CONFIG_MEMFAULT_NCS_FW_VERSION_STATIC=y
CONFIG_MEMFAULT_NCS_FW_VERSION="0.0.1"

# Required for logging backends to work as expected
CONFIG_LOG=y
CONFIG_LOG_BACKEND_UART=y

# Enable capture of recent logs as part of a coredump
CONFIG_MEMFAULT_LOGGING_ENABLE=y

# Enable Flash and Bootloader components for for flash-backed coredump storage
CONFIG_BOOTLOADER_MCUBOOT=y
CONFIG_MCUBOOT_IMG_MANAGER=y
CONFIG_IMG_MANAGER=y
CONFIG_FLASH=y

CONFIG_WATCHDOG=y
```

## src/main.c
```c
/*
 * Copyright (c) 2019 Jan Van Winkel <jan.van_winkel@dxplore.eu>
 *
 * SPDX-License-Identifier: Apache-2.0
 */

#include <stdio.h>

#include <drivers/hwinfo.h>
#include <memfault_ncs.h>

#include <memfault/components.h>

#define LOG_LEVEL CONFIG_LOG_DEFAULT_LEVEL
#include <logging/log.h>
LOG_MODULE_REGISTER(app);

static void set_device_id(void) {
  uint8_t dev_id[16];
  char dev_id_str[33];
  char *dev_str = "UNKNOWN";

  (void)memset(dev_id, 0x0, sizeof(dev_id));

  /* Obtain the device id */
  ssize_t length = hwinfo_get_device_id(dev_id, sizeof(dev_id));

  /* If this fails for some reason, use a fixed ID instead */
  if (length <= 0) {
    dev_str = CONFIG_SOC_SERIES "-test";
    length = strlen(dev_str);
  } else {
    /* Render the obtained serial number in hexadecimal representation */
    for (size_t i = 0; i < length; i++) {
      sprintf(&dev_id_str[i * 2], "%02x", dev_id[i]);
    }
    dev_str = dev_id_str;
  }

  printk("Device ID: %s\n", dev_str);

  memfault_ncs_device_id_set(dev_str, length * 2);
}

void main(void) {
  // Set the device id based on the hardware UID
  set_device_id();

  memfault_device_info_dump();
}
```
